## examples/common/rmaker_matter_controller/Kconfig
```kconfig
menu "ESP Rainmaker Controller"

    config RAINMAKER_MATTER_CONTROLLER_TASK_STACK
        int "ESP Rainmaker Matter Controller Task Stack Size"
        default 7168
        help
            Set the stack size of ESP Rainmaker Matter Controller task.

    config RAINMAKER_MATTER_CONTROLLER_ATTR_REPORT_TASK_STACK
        int "ESP Rainmaker Matter Controller Attribute Report Task Stack Size"
        default 8192
        help
            Set the stack size of ESP Rainmaker Matter Controller attribute report task.

    config RAINMAKER_MATTER_CONTROLLER_ATTR_BATCH_BUCKET_CAPACITY
        int "ESP Rainmaker Matter Controller Attribute Report Batch Bucket Capacity"
        default 3
        help
            Set the number of attribute report batches that may be published quickly after an idle period.

    config RAINMAKER_MATTER_CONTROLLER_ATTR_BATCH_REFILL_MS
        int "ESP Rainmaker Matter Controller Attribute Report Batch Token Refill (ms)"
        default 10000
        help
            Set the token refill interval used to bound sustained RainMaker attribute report publish rate.

    config RAINMAKER_MATTER_CONTROLLER_MEM_ALLOC_MODE_EXTERNAL
        bool "Allocate ESP Rainmaker Matter Controller buffers in external memory"
        depends on SPIRAM && (SPIRAM_USE_CAPS_ALLOC || SPIRAM_USE_MALLOC) && FREERTOS_SUPPORT_STATIC_ALLOCATION
        default y
        help
            Allocate buffers in external memory when available. This saves internal heap.

    config RAINMAKER_MATTER_CONTROLLER_MAX_ENDPOINT_COUNT_PER_DEVICE
        int "ESP Rainmaker Matter Controller Max Endpoint Count Per Device"
        range 1 16
        default 4
        help
            Set the maximum endpoint count per device for ESP Rainmaker Matter Controller.

    config RAINMAKER_MATTER_CONTROLLER_MAX_DEVICE_TYPE_COUNT_PER_ENDPOINT
        int "ESP Rainmaker Matter Controller Max Device Type Count Per Endpoint"
        range 1 16
        default 4
        help
            Set the maximum device type count per endpoint for ESP Rainmaker Matter Controller.

endmenu
```

## examples/lvgl_sr/sdkconfig.defaults
```kconfig
CONFIG_PARTITION_TABLE_CUSTOM=y
CONFIG_PARTITION_TABLE_FILENAME="partitions.csv"

CONFIG_COMPILER_OPTIMIZATION_PERF=y

CONFIG_SPIRAM=y
CONFIG_SPIRAM_ALLOW_BSS_SEG_EXTERNAL_MEMORY=y

CONFIG_FREERTOS_HZ=1000
CONFIG_FREERTOS_SUPPORT_STATIC_ALLOCATION=y
CONFIG_FREERTOS_TASK_CREATE_ALLOW_EXT_MEM=y
CONFIG_ESP_MAIN_TASK_STACK_SIZE=6144

CONFIG_ESP_LVGL_ADAPTER_ENABLE_FPS_STATS=y

CONFIG_LV_BUILD_EXAMPLES=n
CONFIG_LV_BUILD_DEMOS=n
CONFIG_LV_COLOR_DEPTH_16=y
CONFIG_LV_USE_CLIB_MALLOC=y
CONFIG_LV_USE_CLIB_STRING=y
CONFIG_LV_USE_CLIB_SPRINTF=y
CONFIG_LV_OBJ_STYLE_CACHE=y
CONFIG_LV_DEF_REFR_PERIOD=15

CONFIG_SR_WN_WN9_HIESP=y
```

## examples/matter/matter_controller_with_touchscreen/components/agent_ng/Kconfig.projbuild
```kconfig
menu "Agent NG Configuration"

config AGENT_NG_API_ENDPOINT
    string "Agent API endpoint"
    default "api.agents.espressif.com"

endmenu
```

## examples/matter/matter_controller_with_touchscreen/main/Kconfig.projbuild
```kconfig
menu "Matter Touchscreen Agent Configuration"

    config APP_AGENT_ID
        string "Agent ID"
        default "LZ2Z36A53GWTQ5C8ZH7M5FZGMKOP951Q"
        help
            Cloud agent identifier used after RainMaker credentials become available.

endmenu
```

## examples/matter/matter_controller_with_touchscreen/sdkconfig.defaults
```kconfig
CONFIG_IDF_TARGET="esp32s31"
CONFIG_ESPTOOLPY_FLASHSIZE_16MB=y

CONFIG_PARTITION_TABLE_CUSTOM=y
CONFIG_PARTITION_TABLE_FILENAME="partitions.csv"
CONFIG_PARTITION_TABLE_OFFSET=0x8000
CONFIG_PARTITION_TABLE_MD5=y

CONFIG_COMPILER_OPTIMIZATION_PERF=y
CONFIG_ESP_PANIC_HANDLER_IRAM=1

# Board manager
CONFIG_ESP_BOARD_MANAGER_AUTO_CONFIG_DEVICE_AND_PERIPHERAL=y

# Disable the DS peripheral support in demo
CONFIG_ESP_SECURE_CERT_DS_PERIPHERAL=n

# PSRAM
CONFIG_SPIRAM=y
CONFIG_SPIRAM_SPEED_200M=y
CONFIG_SPIRAM_MALLOC_ALWAYSINTERNAL=0
CONFIG_SPIRAM_ALLOW_BSS_SEG_EXTERNAL_MEMORY=y
CONFIG_FREERTOS_SUPPORT_STATIC_ALLOCATION=y
CONFIG_FREERTOS_TASK_CREATE_ALLOW_EXT_MEM=y
CONFIG_BT_ALLOCATION_FROM_SPIRAM_FIRST=y
CONFIG_BT_NIMBLE_MEM_ALLOC_MODE_EXTERNAL=y
CONFIG_MBEDTLS_EXTERNAL_MEM_ALLOC=y
CONFIG_ESP_MATTER_MEM_ALLOC_MODE_EXTERNAL=y
CONFIG_CHIP_MEM_ALLOC_MODE_EXTERNAL=y
CONFIG_RMAKER_MTCTL_MEMORY_ALLOCATION_PREFER_SPIRAM=y
CONFIG_RMAKER_MTCTL_MEMORY_REPORT_TASK_CREATE_FROM_SPIRAM=y

# ESP Speech Recognition
CONFIG_SR_WN_WN9_HIESP=y

# FreeRTOS
CONFIG_FREERTOS_PLACE_FUNCTIONS_INTO_FLASH=y
CONFIG_FREERTOS_HZ=1000

# Stack size
CONFIG_FREERTOS_TIMER_TASK_STACK_DEPTH=4096
CONFIG_ESP_SYSTEM_EVENT_TASK_STACK_SIZE=4096
CONFIG_ESP_MAIN_TASK_STACK_SIZE=8192

# Bluetooth
CONFIG_BT_ENABLED=y
CONFIG_BT_NIMBLE_ENABLED=y
CONFIG_BT_NIMBLE_HOST_TASK_STACK_SIZE=5120

# LwIP
CONFIG_LWIP_IPV6_AUTOCONFIG=y
CONFIG_LWIP_HOOK_IP6_ROUTE_DEFAULT=y
CONFIG_LWIP_HOOK_ND6_GET_GW_DEFAULT=y
CONFIG_LWIP_TCPIP_RECVMBOX_SIZE=32
CONFIG_LWIP_TCPIP_TASK_STACK_SIZE=4096
CONFIG_LWIP_UDP_RECVMBOX_SIZE=32
CONFIG_LWIP_IPV6_NUM_ADDRESSES=6

# MbedTLS
CONFIG_MBEDTLS_DYNAMIC_BUFFER=y
CONFIG_MBEDTLS_DYNAMIC_FREE_CONFIG_DATA=y
CONFIG_MBEDTLS_TLS_CLIENT_ONLY=y
CONFIG_MBEDTLS_HKDF_C=y

# MQTT
CONFIG_MQTT_USE_CUSTOM_CONFIG=y
CONFIG_MQTT_TASK_STACK_SIZE=8192

# WebSocket
CONFIG_WS_BUFFER_SIZE=2048

# LVGL Generic
CONFIG_LV_BUILD_EXAMPLES=n
CONFIG_LV_BUILD_DEMOS=n
CONFIG_LV_COLOR_DEPTH_16=y
CONFIG_LV_FONT_FMT_TXT_LARGE=y
CONFIG_LV_FONT_MONTSERRAT_28=y
CONFIG_LV_FONT_MONTSERRAT_32=y
CONFIG_LV_FONT_MONTSERRAT_48=y
CONFIG_LV_USE_FONT_COMPRESSED=y
CONFIG_LV_USE_QRCODE=y

# LVGL Perf
CONFIG_LV_USE_CLIB_MALLOC=y
CONFIG_LV_USE_CLIB_STRING=y
CONFIG_LV_USE_CLIB_SPRINTF=y
CONFIG_LV_OBJ_STYLE_CACHE=y

# ESP RainMaker
CONFIG_ESP_RMAKER_USER_ID_CHECK=y
CONFIG_ESP_RMAKER_ASSISTED_CLAIM=y
CONFIG_ESP_RMAKER_USE_NVS=y
CONFIG_APP_NETWORK_PROV_SHOW_QR=n

# If ESP-Insights is enabled, we need MQTT transport selected
# Takes out manual efforts to enable this option
CONFIG_ESP_INSIGHTS_TRANSPORT_MQTT=y

# Matter
CONFIG_CHIP_PROJECT_CONFIG="main/matter_project_config.h"
CONFIG_CHIP_TASK_STACK_SIZE=8192
CONFIG_CHIP_FACTORY_NAMESPACE_PARTITION_LABEL="fctry"
CONFIG_ENABLE_ESP32_FACTORY_DATA_PROVIDER=y
CONFIG_ENABLE_ESP32_DEVICE_INSTANCE_INFO_PROVIDER=y
CONFIG_ENABLE_ESP32_DEVICE_INFO_PROVIDER=y
CONFIG_SEC_CERT_DAC_PROVIDER=y
CONFIG_DEVICE_VENDOR_ID=0x131B
CONFIG_DEVICE_PRODUCT_ID=0x2
CONFIG_ENABLE_OTA_REQUESTOR=n
CONFIG_ENABLE_MATTER_OVER_THREAD=n
CONFIG_BUILD_CHIP_TESTS=n
CONFIG_ENABLE_CHIP_SHELL=y
CONFIG_ESP_MATTER_CONSOLE_TASK_STACK=4096

# Disable Matter over SoftAP and BLE
CONFIG_ENABLE_WIFI_AP=n
CONFIG_ENABLE_CHIPOBLE=n
CONFIG_USE_BLE_ONLY_FOR_COMMISSIONING=n

# Disable network commissioning driver
CONFIG_WIFI_NETWORK_COMMISSIONING_DRIVER=n
CONFIG_THREAD_NETWORK_COMMISSIONING_DRIVER=n

# Matter commissioning Window should be closed on starting
CONFIG_CHIP_ENABLE_PAIRING_AUTOSTART=n

# Matter controller
CONFIG_ESP_MATTER_ENABLE_MATTER_SERVER=n
CONFIG_ESP_MATTER_COMMISSIONER_ENABLE=n
CONFIG_ENABLE_CHIP_CONTROLLER_BUILD=y
CONFIG_ESP_MATTER_CONTROLLER_ENABLE=y
CONFIG_CUSTOM_OPERATIONAL_CREDS_ISSUER=y
CONFIG_MAX_EXCHANGE_CONTEXTS=40
CONFIG_ESP_MATTER_ATTRIBUTE_BUFFER_LARGEST=2560
CONFIG_RMAKER_MTCTL_TASK_STACK_SIZE=8192
```
