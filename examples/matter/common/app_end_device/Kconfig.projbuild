## examples/matter/common/app_end_device/Kconfig.projbuild
```kconfig
menu "RainMaker Matter End Device"

config APP_END_DEVICE_BOARD_BUTTON_GPIO
    int "Boot Button GPIO"
    default 28 if IDF_TARGET_ESP32C5
    default 9 if IDF_TARGET_ESP32C3 || IDF_TARGET_ESP32C6 || IDF_TARGET_ESP32C2 || IDF_TARGET_ESP32H2
    default 0
    help
        GPIO number on which the "Boot" button is connected.

endmenu
```

## examples/matter/matter_bridge_with_controller/sdkconfig.defaults
```kconfig
# Flashing / console
CONFIG_ESPTOOLPY_BAUD_921600B=y
CONFIG_ESPTOOLPY_BAUD=921600
CONFIG_ESPTOOLPY_COMPRESSED=y
CONFIG_ESPTOOLPY_MONITOR_BAUD_115200B=y
CONFIG_ESPTOOLPY_MONITOR_BAUD=115200
CONFIG_ESPTOOLPY_FLASHSIZE_8MB=y
# CONFIG_ESP_CONSOLE_USB_SERIAL_JTAG=y

# Partition layout
CONFIG_PARTITION_TABLE_CUSTOM=y
CONFIG_PARTITION_TABLE_CUSTOM_FILENAME="partitions.csv"
CONFIG_PARTITION_TABLE_OFFSET=0x8000
CONFIG_PARTITION_TABLE_MD5=y

# Connectivity
CONFIG_BT_ENABLED=y
CONFIG_BT_NIMBLE_ENABLED=y
CONFIG_LWIP_IPV6_AUTOCONFIG=y
CONFIG_LWIP_HOOK_IP6_ROUTE_DEFAULT=y
CONFIG_LWIP_HOOK_ND6_GET_GW_DEFAULT=y
CONFIG_LWIP_IPV6_NUM_ADDRESSES=6
CONFIG_USE_MINIMAL_MDNS=n

# Matter platform / credentials
CONFIG_ENABLE_CHIP_SHELL=y
CONFIG_CHIP_FACTORY_NAMESPACE_PARTITION_LABEL="fctry"
CONFIG_ENABLE_ESP32_FACTORY_DATA_PROVIDER=y
CONFIG_ENABLE_ESP32_DEVICE_INSTANCE_INFO_PROVIDER=y
CONFIG_ENABLE_ESP32_DEVICE_INFO_PROVIDER=y
CONFIG_SEC_CERT_DAC_PROVIDER=y
CONFIG_ESP_SECURE_CERT_DS_PERIPHERAL=n
CONFIG_USE_ESP32_ECDSA_PERIPHERAL=n
CONFIG_DEVICE_VENDOR_ID=0x131B
CONFIG_DEVICE_PRODUCT_ID=0x2

# Matter controller role
CONFIG_ESP_MATTER_CONTROLLER_ENABLE=y
CONFIG_ESP_MATTER_COMMISSIONER_ENABLE=n
CONFIG_ESP_MATTER_ENABLE_MATTER_SERVER=y
CONFIG_ESP_MATTER_CONTROLLER_CUSTOM_CLUSTER_ENABLE=n
CONFIG_ESP_MATTER_ATTRIBUTE_BUFFER_LARGEST=2050
CONFIG_NUM_UDP_ENDPOINTS=16

# RainMaker integration
CONFIG_ESP_RMAKER_USER_ID_CHECK=y
CONFIG_ESP_RMAKER_NO_CLAIM=y
CONFIG_ESP_RMAKER_USE_ESP_SECURE_CERT_MGR=y
CONFIG_ESP_RMAKER_READ_NODE_ID_FROM_CERT_CN=y

# MQTT / Insights
CONFIG_MQTT_USE_CUSTOM_CONFIG=y
CONFIG_MQTT_TASK_STACK_SIZE=8192
CONFIG_ESP_INSIGHTS_TRANSPORT_MQTT=y

# mbedTLS
CONFIG_MBEDTLS_DYNAMIC_BUFFER=y
CONFIG_MBEDTLS_DYNAMIC_FREE_PEER_CERT=y
CONFIG_MBEDTLS_DYNAMIC_FREE_CONFIG_DATA=y
CONFIG_MBEDTLS_HKDF_C=y

# Task stack sizing
CONFIG_FREERTOS_TIMER_TASK_STACK_DEPTH=3120
CONFIG_ESP_SYSTEM_EVENT_TASK_STACK_SIZE=4096
CONFIG_ESP_MATTER_CONSOLE_TASK_STACK=5120
CONFIG_MQTT_TASK_STACK_SIZE=8192
CONFIG_ESP_MAIN_TASK_STACK_SIZE=10240
CONFIG_CHIP_TASK_STACK_SIZE=15360
```

## examples/matter/matter_controller/sdkconfig.defaults
```kconfig
CONFIG_IDF_TARGET="esp32s3"

CONFIG_ESPTOOLPY_BAUD_921600B=y
CONFIG_ESPTOOLPY_BAUD=921600
CONFIG_ESPTOOLPY_COMPRESSED=y
CONFIG_ESPTOOLPY_MONITOR_BAUD_115200B=y
CONFIG_ESPTOOLPY_MONITOR_BAUD=115200

CONFIG_ESPTOOLPY_FLASHSIZE_8MB=y

CONFIG_PARTITION_TABLE_CUSTOM=y
CONFIG_PARTITION_TABLE_FILENAME="partitions.csv"
CONFIG_PARTITION_TABLE_OFFSET=0x8000
CONFIG_PARTITION_TABLE_MD5=y

# Disable the DS peripheral support in demo
CONFIG_ESP_SECURE_CERT_DS_PERIPHERAL=n

# Temporary fix for timer overflows
CONFIG_FREERTOS_TIMER_TASK_STACK_DEPTH=4096

# Increase UDP endpoints number
CONFIG_NUM_UDP_ENDPOINTS=16

# SPIRAM
CONFIG_SPIRAM=y
CONFIG_SPIRAM_MODE_OCT=y
CONFIG_SPIRAM_SPEED_80M=y
CONFIG_SPIRAM_MALLOC_ALWAYSINTERNAL=512
CONFIG_SPIRAM_MALLOC_RESERVE_INTERNAL=8192
CONFIG_SPIRAM_ALLOW_BSS_SEG_EXTERNAL_MEMORY=y
CONFIG_SPIRAM_TRY_ALLOCATE_WIFI_LWIP=y
CONFIG_ESP_ALLOW_BSS_SEG_EXTERNAL_MEMORY=y
CONFIG_BT_NIMBLE_MEM_ALLOC_MODE_EXTERNAL=y
CONFIG_ESP_MATTER_MEM_ALLOC_MODE_EXTERNAL=y
CONFIG_MBEDTLS_EXTERNAL_MEM_ALLOC=y
CONFIG_ESP_MATTER_MEM_ALLOC_MODE_EXTERNAL=y
CONFIG_RAINMAKER_MATTER_CONTROLLER_MEM_ALLOC_MODE_EXTERNAL=y

# Stack size
CONFIG_ESP_SYSTEM_EVENT_TASK_STACK_SIZE=4096
CONFIG_ESP_MATTER_CONSOLE_TASK_STACK=4096
CONFIG_CHIP_TASK_STACK_SIZE=8192
CONFIG_ESP_MAIN_TASK_STACK_SIZE=8192

# Bluetooth
CONFIG_BT_ENABLED=y
CONFIG_BT_NIMBLE_ENABLED=y

# LwIP
CONFIG_LWIP_IPV6_AUTOCONFIG=y
CONFIG_LWIP_HOOK_IP6_ROUTE_DEFAULT=y
CONFIG_LWIP_HOOK_ND6_GET_GW_DEFAULT=y
CONFIG_LWIP_TCPIP_RECVMBOX_SIZE=16
CONFIG_LWIP_IPV6_NUM_ADDRESSES=6

# MbedTLS
CONFIG_MBEDTLS_EXTERNAL_MEM_ALLOC=y
CONFIG_MBEDTLS_DYNAMIC_BUFFER=y
CONFIG_MBEDTLS_DYNAMIC_FREE_PEER_CERT=y
CONFIG_MBEDTLS_DYNAMIC_FREE_CONFIG_DATA=y
CONFIG_MBEDTLS_SSL_PROTO_TLS1=n
CONFIG_MBEDTLS_SSL_PROTO_TLS1_1=n
CONFIG_MBEDTLS_TLS_CLIENT_ONLY=y
CONFIG_MBEDTLS_HKDF_C=y

# ESP RainMaker
CONFIG_ESP_RMAKER_USER_ID_CHECK=y
CONFIG_ESP_RMAKER_ASSISTED_CLAIM=y
CONFIG_ESP_RMAKER_USE_NVS=y
CONFIG_APP_NETWORK_PROV_SHOW_QR=y

# ESP Matter
CONFIG_CHIP_FACTORY_NAMESPACE_PARTITION_LABEL="fctry"
CONFIG_ENABLE_ESP32_FACTORY_DATA_PROVIDER=y
CONFIG_ENABLE_ESP32_DEVICE_INSTANCE_INFO_PROVIDER=y
CONFIG_ENABLE_ESP32_DEVICE_INFO_PROVIDER=y
CONFIG_SEC_CERT_DAC_PROVIDER=y
CONFIG_DEVICE_VENDOR_ID=0x131B
CONFIG_DEVICE_PRODUCT_ID=0x2
CONFIG_ESP_MATTER_ATTRIBUTE_BUFFER_LARGEST=2050
CONFIG_ENABLE_CHIP_SHELL=y

# Disable Matter over SoftAP and BLE
CONFIG_ENABLE_WIFI_AP=n
CONFIG_ENABLE_CHIPOBLE=n
CONFIG_USE_BLE_ONLY_FOR_COMMISSIONING=n

# Disable network commissioning driver
CONFIG_WIFI_NETWORK_COMMISSIONING_DRIVER=n
CONFIG_THREAD_NETWORK_COMMISSIONING_DRIVER=n

# Matter commissioning Window should be closed on starting
CONFIG_CHIP_ENABLE_PAIRING_AUTOSTART=n

# Matter controller
CONFIG_ESP_MATTER_ENABLE_MATTER_SERVER=n
CONFIG_ENABLE_CHIP_CONTROLLER_BUILD=y
CONFIG_ESP_MATTER_CONTROLLER_ENABLE=y
CONFIG_ESP_MATTER_COMMISSIONER_ENABLE=n
CONFIG_ESP_MATTER_CONTROLLER_CUSTOM_CLUSTER_ENABLE=n
CONFIG_CUSTOM_OPERATIONAL_CREDS_ISSUER=y

# If ESP-Insights is enabled, we need MQTT transport selected
# Takes out manual efforts to enable this option
CONFIG_ESP_INSIGHTS_TRANSPORT_MQTT=y
```

## examples/matter/matter_light/main/Kconfig.projbuild
```kconfig
menu "Example Config"

    config APP_LIGHT_LED_WS2812_GPIO
        int "WS2812 LED GPIO"
        default 8 if IDF_TARGET_ESP32C2 || IDF_TARGET_ESP32C3 || IDF_TARGET_ESP32C6 || IDF_TARGET_ESP32H2
        default 48 if IDF_TARGET_ESP32S3
        default 18
        help
            GPIO number for the WS2812 RGB LED.
     
    config EXAMPLE_USE_RAINMAKER_FABRIC
        bool "Use RainMaker plus Matter fabric solution"
        default y
        help
            Enable this option to make example run RainMaker plus Matter fabric solution. If want to use no fabric solution, disable it.

    config DYNAMIC_PASSCODE_COMMISSIONABLE_DATA_PROVIDER
        bool "Enable Dynamic Passcode Commissionable Data Provider"
        depends on !EXAMPLE_USE_RAINMAKER_FABRIC && CUSTOM_COMMISSIONABLE_DATA_PROVIDER
        default n

    config DYNAMIC_PASSCODE_PROVIDER_DISCRIMINATOR
        int "Discriminator in Dynamic Passcode Commissionable Data Provider"
        depends on DYNAMIC_PASSCODE_COMMISSIONABLE_DATA_PROVIDER
        default 3840
        range 0 4095
        help
            Fixed discriminator in custom dynamic passcode commissionable data provider

    config DYNAMIC_PASSCODE_PROVIDER_ITERATIONS
        int "Iterations in Dynamic Passcode Commissionable Data Provider"
        depends on DYNAMIC_PASSCODE_COMMISSIONABLE_DATA_PROVIDER
        default 10000
        range 1000 100000
        help
            Fixed iterations in custom dynamic passcode commissionable data provider

    config DYNAMIC_PASSCODE_PROVIDER_SALT_BASE64
        string "Base64-Encoded Salt in Dynamic Passcode Commissionable Data Provider"
        depends on DYNAMIC_PASSCODE_COMMISSIONABLE_DATA_PROVIDER
        default "0NHS09TV1tfY2drb3N3e36ChoqOkpaanqKmqq6ytrq8="
        help
            Fixed salt in custom dynamic passcode commissionable data provider. It should be a Base64-Encoded string.

endmenu
```

## examples/matter/matter_light/sdkconfig.defaults.esp32c6
```kconfig
#
# Use partition table which makes use of flash to the fullest
# Can be used for other platforms as well. But please keep in mind that fctry partition address is
# different than default, and the new address needs to be specified to `rainmaker.py claim`
#
CONFIG_PARTITION_TABLE_CUSTOM=y
CONFIG_PARTITION_TABLE_CUSTOM_FILENAME="partitions_4mb_optimised.csv"

# To accomodate security features
CONFIG_PARTITION_TABLE_OFFSET=0xc000

# End-device button defaults
CONFIG_APP_END_DEVICE_BOARD_BUTTON_GPIO=9
```

## examples/matter/matter_switch/main/Kconfig.projbuild
```kconfig
menu "Example Config"

    config APP_SWITCH_LED_GPIO
        int "Switch LED GPIO"
        default 5 if IDF_TARGET_ESP32
        default 38 if IDF_TARGET_ESP32S3
        default 8
        help
            GPIO number for the switch LED.

endmenu
```
